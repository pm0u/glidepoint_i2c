## boards/shields/glidepoint_i2c_adapter/Kconfig.shield
```kconfig
config SHIELD_GLIDEPOINT_I2C_ADAPTER
    def_bool $(shields_list_contains,glidepoint_i2c_adapter)
```

## boards/shields/glidepoint_i2c_split/Kconfig.shield
```kconfig
config SHIELD_GLIDEPOINT_I2C_SPLIT
                def_bool $(shields_list_contains,glidepoint_i2c_split)
```

## boards/shields/glidepoint_i2c_split_central/Kconfig.shield
```kconfig
    config SHIELD_GLIDEPOINT_I2C_SPLIT_CENTRAL
    def_bool $(shields_list_contains,glidepoint_i2c_split_central)
```

## boards/shields/glidepoint_i2c_split_peripheral/Kconfig.shield
```kconfig
config SHIELD_GLIDEPOINT_I2C_SPLIT_PERIPHERAL
    def_bool $(shields_list_contains,glidepoint_i2c_split_peripheral)
```
